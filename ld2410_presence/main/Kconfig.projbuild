## ld2410_presence/main/Kconfig.projbuild
```kconfig
menu "LD2410 Presence Sensor Configuration"

    # ESP32-H2 exposes GPIO0-5, GPIO8-14 and GPIO22-27.

    config LD2410_UART_TX_GPIO
        int "ESP32-H2 TX GPIO (to LD2410 RX)"
        range 0 27
        default 3
        help
            ESP32-H2 UART TX, wired to the RX pin of the LD2410.
            GPIO3 is a strapping pin; it is only sampled at reset and the
            LD2410 RX input does not drive it, so it is safe to use.

    config LD2410_UART_RX_GPIO
        int "ESP32-H2 RX GPIO (from LD2410 TX)"
        range 0 27
        default 4
        help
            ESP32-H2 UART RX, wired to the TX pin of the LD2410.

    config LD2410_BAUD_RATE
        int "LD2410 UART baud rate"
        default 256000
        help
            Factory default of the LD2410/LD2410B/LD2410C is 256000 baud.

    config LD2410_APPLY_CONFIG
        bool "Write gate / no-one duration settings to the radar at boot"
        default y
        help
            If enabled, the firmware sends the "max distance gate & no-one
            duration" command (0x0060) at every boot. Disable to keep the
            settings made with the HLKRadarTool app.

    config LD2410_MAX_GATE
        int "Max detection gate (moving and stationary, 1 gate = 0.75 m)"
        range 2 8
        default 8
        depends on LD2410_APPLY_CONFIG

    config LD2410_NO_ONE_DURATION
        int "No-one duration (seconds before reporting unoccupied)"
        range 0 65535
        default 10
        depends on LD2410_APPLY_CONFIG

    config BUTTON_GPIO
        int "Button GPIO number (-1 to disable)"
        range -1 27
        default 9
        help
            Push button to GND (GPIO9 = on-board BOOT button).
            Hold >= RESET_HOLD_SECONDS to leave the network and factory
            reset the Zigbee stack.

    config RESET_HOLD_SECONDS
        int "Hold time for factory reset (seconds)"
        range 3 30
        default 5
        depends on BUTTON_GPIO >= 0

endmenu
```

## main/Kconfig.projbuild
```kconfig
menu "Zigbee Relay Configuration"

    # ESP32-H2 exposes GPIO0-5, GPIO8-14 and GPIO22-27.
    # Avoid strapping pins GPIO2/3/8/9/25, GPIO26/27 (USB D-/D+)
    # and GPIO23/24 (UART0 console) for the relay.

    config RELAY_GPIO
        int "Relay GPIO number"
        range 0 27
        default 12
        help
            GPIO that drives the relay (relay module IN pin, or the base of
            the transistor/optocoupler).

    config RELAY_ACTIVE_HIGH
        bool "Relay is active-high"
        default y
        help
            Enable if writing 1 to the GPIO energises the relay.
            Disable for active-low ("low level trigger") relay modules.

    config BUTTON_GPIO
        int "Button GPIO number (-1 to disable)"
        range -1 27
        default 9
        help
            Local push button (to GND, internal pull-up is enabled).
            GPIO9 is the on-board BOOT button. Short press toggles the
            relay, hold >= RESET_HOLD_SECONDS leaves the network and
            performs a Zigbee factory reset. Set to -1 to disable.

    config RESET_HOLD_SECONDS
        int "Hold time for factory reset (seconds)"
        range 3 30
        default 5
        depends on BUTTON_GPIO >= 0

    config STATUS_LED_GPIO
        int "Status LED GPIO number (-1 to disable)"
        range -1 27
        default -1
        help
            Simple (non-addressable) LED that mirrors the relay state.
            ESP32-H2-DevKitM-1 has an addressable RGB LED on GPIO8, so the
            default is disabled.

    config STATUS_LED_ACTIVE_LOW
        bool "Status LED is active-low"
        default n
        depends on STATUS_LED_GPIO >= 0

    config RESTORE_RELAY_STATE
        bool "Restore relay state after power loss"
        default y
        help
            Save the relay state in NVS and restore it at boot.

endmenu
```
